## main/boards/s3-inmp441-max98357-ili9341/sdkconfig.defaults
```kconfig
CONFIG_XIAOZHI_BOARD_CUSTOM=y

# INMP441 I2S 麦克风
CONFIG_XIAOZHI_AUDIO_INPUT_I2S=y
CONFIG_XIAOZHI_I2S_MIC_BCLK_GPIO=4
CONFIG_XIAOZHI_I2S_MIC_WS_GPIO=5
CONFIG_XIAOZHI_I2S_MIC_DIN_GPIO=6

# MAX98357 I2S 功放喇叭
CONFIG_XIAOZHI_AUDIO_OUTPUT_I2S=y
CONFIG_XIAOZHI_I2S_SPK_BCLK_GPIO=7
CONFIG_XIAOZHI_I2S_SPK_WS_GPIO=8
CONFIG_XIAOZHI_I2S_SPK_DOUT_GPIO=13

# ILI9341 屏幕
CONFIG_XIAOZHI_DISPLAY_ILI9341=y
CONFIG_XIAOZHI_DISPLAY_SPI_SCLK_GPIO=12
CONFIG_XIAOZHI_DISPLAY_SPI_MOSI_GPIO=11
CONFIG_XIAOZHI_DISPLAY_SPI_CS_GPIO=10
CONFIG_XIAOZHI_DISPLAY_SPI_DC_GPIO=9
CONFIG_XIAOZHI_DISPLAY_SPI_RST_GPIO=16

# 离线唤醒词
CONFIG_XIAOZHI_WAKE_WORD=y
CONFIG_XIAOZHI_WAKE_WORD_MODEL="nihaodoubao"
```
